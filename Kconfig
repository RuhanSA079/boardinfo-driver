## Kconfig
```kconfig
#
# boardinfo drivers
#
# When adding new entries keep the list in alphabetical order

config BOARDINFO
        tristate "Device boardinfo"
        default y
        depends on OF
        help
          Driver to set board information from the Devicetree
```
